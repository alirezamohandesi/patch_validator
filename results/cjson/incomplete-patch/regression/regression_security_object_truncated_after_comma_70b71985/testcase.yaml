## results/cjson/incomplete-patch/regression/regression_security_object_truncated_after_comma_70b71985/testcase.yaml
```yaml
tests:
- id: regression_security_object_truncated_after_comma_70b71985
  category: security
  note: generated from finding sec/security_object_truncated_after_comma/sanitized;
    minimized reproducer for HEAP_BUFFER_OVERFLOW at cJSON.c:787
  input:
    path: regression/regression_security_object_truncated_after_comma_70b71985/input.bin
  oracle:
    source: upstream_docs
    input_validity: invalid
    instructor_approved: pending
    exit_code: 1
    stderr:
      match: contains
      value: invalid json
    semantics: An object that ends immediately after a member separator is incomplete
      and must be rejected without reading past the supplied length.
```

## results/recparse/correct-patch/regression/regression_boundary_raw32_83e50dc6/testcase.yaml
```yaml
tests:
- id: regression_boundary_raw32_83e50dc6
  category: security
  note: generated from finding sec/boundary_raw32/sanitized; minimized reproducer
    for STACK_BUFFER_OVERFLOW at src/record.c:22
  input:
    path: regression/regression_boundary_raw32_83e50dc6/input.bin
  oracle:
    source: specification
    input_validity: boundary
    instructor_approved: pending
    exit_code: 2
    stdout:
      match: exact
      value: 'records: 1

        '
    stderr:
      match: contains
      value: too long
    semantics: Length 32 must be rejected for RAW as well as TEXT.
```

## results/recparse/correct-patch/regression/regression_boundary_text32_81a3c2ba/testcase.yaml
```yaml
tests:
- id: regression_boundary_text32_81a3c2ba
  category: security
  note: generated from finding sec/boundary_text32/sanitized; minimized reproducer
    for STACK_BUFFER_OVERFLOW at src/record.c:22
  input:
    path: regression/regression_boundary_text32_81a3c2ba/input.bin
  oracle:
    source: specification
    input_validity: boundary
    instructor_approved: pending
    exit_code: 2
    stdout:
      match: exact
      value: 'records: 1

        '
    stderr:
      match: contains
      value: too long
    semantics: Length 32 must be rejected, not truncated and not processed.
```

## results/recparse/regression-patch/regression/regression_vuln_text_long_901649ba/testcase.yaml
```yaml
tests:
- id: regression_vuln_text_long_901649ba
  category: security
  note: generated from finding sec/vuln_text_long/release; minimized reproducer for
    BUFFER_OVERFLOW at unknown
  input:
    path: regression/regression_vuln_text_long_901649ba/input.bin
  oracle:
    source: specification
    input_validity: invalid
    instructor_approved: pending
    exit_code: 2
    stdout:
      match: exact
      value: 'records: 1

        '
    stderr:
      match: contains
      value: too long
    semantics: An over-long TEXT record must be rejected without any out-of-bounds
      write.
```
